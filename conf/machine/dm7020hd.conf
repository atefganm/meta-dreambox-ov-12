## conf/machine/dm7020hd.conf
```bitbake
#@TYPE: Machine
#@NAME: Dreambox DM7020HD
#@DESCRIPTION: Machine configuration for the Dreambox DM7020HD and Dreambox DM7020HDv2

MACHINE_FEATURES += "ci dvd colorlcd128 grautec RCA"

# Broken bootloader can only flash around 100 MB
FLASHSIZE = "96"

MACHINE_ESSENTIAL_EXTRA_RDEPENDS += "dm-bootsplash"

require conf/machine/include/dreambox-hw-ecc.inc

DM7020NANDINC = "${@ '1024mb-2k' if d.getVar('DMTYPE') else '1024mb'}"

require conf/machine/include/dreambox-nand-${DM7020NANDINC}.inc

require conf/machine/include/dreambox-part-1024mb.inc
require conf/machine/include/dreambox-ubi.inc
require conf/machine/include/dreambox-mips32el.inc

PREFERRED_VERSION_linux-dreambox = "3.2"

CHIPSET = "bcm7405"

MACHINE_EXTRA_RRECOMMENDS += "dreambox-enigma2-config"
```

## conf/machine/dm7080.conf
```bitbake
#@TYPE: Machine
#@NAME: Dreambox DM7080
#@DESCRIPTION: Machine configuration for the Dreambox DM7080

MACHINE_FEATURES += "colorlcd128 grautec HDMI-IN-HD"

SOC_FAMILY = "bcm7435"

require conf/machine/include/dreambox-mips32el.inc
require conf/machine/include/dreambox-mips32el-new.inc

MTD_ROOTFS = "mmcblk0p1"
MTD_KERNEL = "mmcblk0p1"
ROOTFS_FILE = "rootfs.tar.bz2"
MTD_BLACK  = "mmcblk0"
```

## conf/machine/dm800se.conf
```bitbake
#@TYPE: Machine
#@NAME: Dreambox DM800se
#@DESCRIPTION: Machine configuration for the Dreambox DM800se

KERNELVERSION = "3.2"

MACHINE_FEATURES += "colorlcd bwlcd96"

FLASHSIZE = "64"

MACHINE_ESSENTIAL_EXTRA_RDEPENDS += "dm-bootsplash"

require conf/machine/include/dreambox-brcmnand.inc
require conf/machine/include/dreambox-nand-64mb.inc
require conf/machine/include/dreambox-part-64mb.inc
require conf/machine/include/dreambox-jffs2.inc
require conf/machine/include/dreambox-mips32el.inc

PREFERRED_VERSION_linux-dreambox = "${KERNELVERSION}"

SOC_FAMILY = "bcm7405"

# Image fails to boot if kernel exceeds some unknown limit, so make that
# explicit here. I don't know what the actual limit is, but 6416679 boots
# and 6604470 didn't.
KERNEL_IMAGE_MAXSIZE = "6500000"
```

## conf/machine/dm820.conf
```bitbake
#@TYPE: Machine
#@NAME: Dreambox DM820
#@DESCRIPTION: Machine configuration for the Dreambox DM820

MACHINE_FEATURES += "colorlcd bwlcd96 HDMI-IN-FHD"

SOC_FAMILY = "bcm7435"

require conf/machine/include/dreambox-mips32el.inc
require conf/machine/include/dreambox-mips32el-new.inc

MTD_ROOTFS = "mmcblk0p1"
MTD_KERNEL = "mmcblk0p1"
ROOTFS_FILE = "rootfs.tar.bz2"
MTD_BLACK  = "mmcblk0"
```

## conf/machine/dm900.conf
```bitbake
#@TYPE: Machine
#@NAME: Dreambox DM900
#@DESCRIPTION: Machine configuration for the Dreambox DM900

MACHINE_FEATURES += " colorlcd390"

SOC_FAMILY = "bcm7252s"
SOC_FAMILY = "bcm7252s"

require conf/machine/include/dreambox-arm.inc
```

## conf/machine/dm920.conf
```bitbake
#@TYPE: Machine
#@NAME: Dreambox DM920
#@DESCRIPTION: Machine configuration for the Dreambox DM920

MACHINE_FEATURES += " colorlcd400"

CHIPSET = "bcm7252s"
SOC_FAMILY = "bcm7252s"

require conf/machine/include/dreambox-arm.inc
```

## conf/machine/dreamone.conf
```bitbake
require conf/distro/multilib.inc

require conf/machine/include/arm/arch-armv8a.inc

MACHINE_EXTRA_RRECOMMENDS = "kernel-modules"

SERIAL_CONSOLES = "1000000;ttyS0"

PREFERRED_PROVIDER_virtual/egl = "meson-mali"
PREFERRED_PROVIDER_virtual/libgles2 = "meson-mali"
PREFERRED_PROVIDER_virtual/libgl = "mesa-gl"
PREFERRED_PROVIDER_virtual/mesa = "mesa-gl"

PREFERRED_PROVIDER_virtual/blindscan-dvbs = "dreambox-blindscan-utils"
PREFERRED_PROVIDER_virtual/blindscan-dvbc = "dreambox-blindscan-utils"

PREFERRED_PROVIDER_virtual/kernel = "linux-dreamone"
PREFERRED_VERSION_linux-dreamone = "4.9%"

UBOOT_ENTRYPOINT = "0x1080000"

KERNEL_CLASSES = "kernel-fitimage"
KERNEL_IMAGETYPE = "Image.gz"

MACHINE_FEATURES = "hdmicec serial usbconsole usbgadget usbhost vfat ext2 rtc alsa screen blindscan-dvbc recovery nogamma multilib"

SOC_FAMILY = "meson64"
require conf/machine/include/soc-family.inc

BOX_BRAND = "dreambox"

MACHINE_ESSENTIAL_EXTRA_RDEPENDS += "\
    bcmdhd \
    bcmdhd-firmware \
    dreambox-dvb-modules \
    flash-nrf52 \
    flash-scripts \
    meson-mali \
    meson-mali-module-bifrost-r12p0 \
    kernel-modules \
    "

KERNEL_MODULE_AUTOLOAD += "\
	mali_kbase \
	dhd \
	stb-core \
	meson64 \
	fp-dev \
	ble \
	videograbber \
	dreamframeinject \
	dreambox_rc2 \
	lcd \
	encoder \
	amvdec_avs \
	amvdec_avs2 \
	amvdec_h264 \
	amvdec_h264mvc \
	amvdec_h265 \
	amvdec_mh264 \
	amvdec_mjpeg \
	amvdec_mmjpeg \
	amvdec_mmpeg4 \
	amvdec_mpeg12 \
	amvdec_mpeg4 \
	amvdec_ports \
	amvdec_real \
	amvdec_vc1 \
	amvdec_vp9 \
	nfsd \
	"

# CC_append_pn-showiframe = " -DHAVE_AMLOGIC"
```

## conf/machine/include/dreambox-mips32el-new.inc
```bitbake
# dreambox-mips32el-new.inc

KERNELVERSION = "3.4"

BOX_BRAND = "dreambox"

PREFERRED_PROVIDER_virtual/egl ?= "libvc5dream"
PREFERRED_PROVIDER_virtual/libgles1 ?= "libvc5dream"
PREFERRED_PROVIDER_virtual/libgles2 ?= "libvc5dream"
PREFERRED_PROVIDER_virtual/libgl ?= "mesa-gl"
PREFERRED_PROVIDER_virtual/mesa ?= "mesa-gl"
PREFERRED_VERSION_linux-dreambox = "${KERNELVERSION}"
PREFERRED_PROVIDER_jpeg ?= "libjpeg-turbo"
PREFERRED_PROVIDER_jpeg-native ?= "libjpeg-turbo-native"

MACHINE_EXTRA_RDEPENDS += "libvc5dream"

DREAMBOX_IMAGE_SIZE ??= "1024"

IMAGE_FSTYPES =+ "tar.xz"

IMAGE_CMD:tar:prepend = "\
	mkdir -p ${IMAGE_ROOTFS}/tmp; \
	rm -Rf ${IMAGE_ROOTFS}/tmp/*; \
	mkdir -p ${IMAGE_ROOTFS}${localstatedir}/lib/opkg/info; \
	echo "#!/bin/sh" > ${IMAGE_ROOTFS}${localstatedir}/lib/opkg/info/dreambox-secondstage.postinst; \
	echo "[ -n \"$D\" ] || flash-ssbl /usr/share/dreambox-secondstage/ssbl.bin" >> ${IMAGE_ROOTFS}${localstatedir}/lib/opkg/info/dreambox-secondstage.postinst; \
	chmod 777 ${IMAGE_ROOTFS}${localstatedir}/lib/opkg/info/dreambox-secondstage.postinst; \
	rm -f ${DEPLOY_DIR_IMAGE}/*.tar.xz; \
	rm -f ${DEPLOY_DIR_IMAGE}/*.zip; \
	"

CONVERSION_CMD:xz:append = ";\
	cd ${DEPLOY_DIR_IMAGE}; \
	cp -f ${IMGDEPLOYDIR}/${IMAGE_NAME}_flash.tar.xz ${DEPLOY_DIR_IMAGE}/${IMAGE_NAME}${IMAGE_NAME_SUFFIX}.tar.xz; \
	echo ${IMAGE_NAME} > ${DEPLOY_DIR_IMAGE}/imageversion; \
	echo "https://forum.openvision.tech/app.php/donate" > ${DEPLOY_DIR_IMAGE}/donate.txt; \
	zip ${IMAGE_NAME}_webif.zip ${IMAGE_NAME}${IMAGE_NAME_SUFFIX}.tar.xz imageversion donate.txt; \
	cd ${IMGDEPLOYDIR}; \
	"

STB_PLATFORM = "dm3gen"

MACHINE_FEATURES += "modem dvb-c blindscan-dvbc hdmicec recovery ci usbconsole HDMI"

RCNAME = "dmm2"

IMAGE_CLASSES += "tarxz-dreambox"

KODIEXTSETTINGS = ""

DVBMEDIASINK_CONFIG:dm7080 = "--with-pcm --with-wma --with-wmv --with-dtsdownmix --with-eac3 --with-dts --with-vb6 --with-vb8 --with-spark"
DVBMEDIASINK_CONFIG:dm820 = "--with-pcm --with-wma --with-wmv --with-dtsdownmix --with-eac3 --with-dts --with-vb6 --with-vb8 --with-spark"
DVBMEDIASINK_CONFIG:dm520 = "--with-pcm --with-wma --with-wmv --with-dtsdownmix --with-eac3 --with-dts --with-vb6 --with-vb8 --with-spark --with-h265"

CFLAGS:append:pn-titan = " -DDREAMBOX -DCONFIG_ION "
```

## conf/machine/include/dreambox-mips32el.inc
```bitbake
# dreambox-mips32el.inc

BOX_BRAND = "dreambox"

TARGET_ARCH = "mipsel"
DEFAULTTUNE = "mips32el"

MTD_KERNEL = "mtd2"

require conf/machine/include/dreambox.inc
require conf/machine/include/mips/tune-mips32.inc

DVBMEDIASINK_CONFIG = "--with-pcm --with-wma --with-wmv --with-dtsdownmix --with-eac3 --with-dts"
DVBMEDIASINK_CONFIG:dm8000 = "--with-pcm --with-wma --with-wmv --with-dtsdownmix --with-eac3 --with-dts --with-limited-mpeg4v2 --with-amr"

CFLAGS:append:pn-titan = " -DDREAMBOX "

KERNEL_FILE = "kernel.bin"
ROOTFS_FILE = "rootfs.bin"

MACHINE_FEATURES += "dreamboxlib"
```

## conf/machine/include/dreambox.inc
```bitbake
# dreambox.inc
# We know about rtc
MACHINE_FEATURES_BACKFILL_CONSIDERED += "rtc"

EXTRA_IMAGEDEPENDS += "dreambox-secondstage-${MACHINE}"

MACHINE_ESSENTIAL_EXTRA_RDEPENDS += "\
	dreambox-dvb-modules-${MACHINE} \
	gstreamer1.0-plugin-dvbmediasink \
	kernel-module-hmac \
	kernel-module-md4 \
	${@bb.utils.contains_any("MACHINE", "dm8000 dm7020hd dm800sev2 dm500hdv2", "kernel-module-ecb", "", d)} \
	dreambox-boot-progress \
	"

MACHINE_FEATURES += "alsa usbhost switchoff dreambox"

PREFERRED_PROVIDER_virtual/bootloader = "dreambox-secondstage-${MACHINE}"
PREFERRED_PROVIDER_virtual/kernel = "linux-dreambox"

PREFERRED_PROVIDER_virtual/blindscan-dvbs = "dreambox-blindscan-utils"
PREFERRED_PROVIDER_virtual/blindscan-dvbc = "dreambox-blindscan-utils"

KERNEL_IMAGETYPE = "vmlinux"
KERNEL_OUTPUT = "${KERNEL_IMAGETYPE}"
KERNEL_OUTPUT_DIR = "."
KERNEL_CONSOLE = "${@bb.utils.contains('MACHINE_FEATURES', 'usbconsole', 'ttyS0,115200', 'null', d)}"

DREAMBOX_BUILDIMAGE = "buildimage --arch ${MACHINE} ${EXTRA_BUILDCMD} \
	--erase-block-size ${DREAMBOX_ERASE_BLOCK_SIZE} \
	--flash-size ${DREAMBOX_FLASH_SIZE} \
	--sector-size ${DREAMBOX_SECTOR_SIZE}"
```
